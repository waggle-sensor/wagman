const int leds[] = {12, 11, 2, 3, 5, 6, 7, 8, 9};
const int numleds = sizeof(leds) / sizeof(int);

void setupLeds() {
    for (int i = 0; i < numleds; i++) {
        pinMode(leds[i], OUTPUT);
    }
}

void setLed(int i, int mode) {    
    if (i >= 0 && i < numleds) {
        digitalWrite(leds[i], mode);
    }
}

void setup() {
    setupLeds();
}

int animation1[12][9] = {
    {1, 1, 1, 0, 0, 0, 0, 0, 0},
    {0, 1, 1, 1, 0, 0, 0, 0, 0},
    {0, 0, 1, 1, 1, 0, 0, 0, 0},
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    {0, 1, 1, 1, 0, 0, 0, 0, 0},
};

int animation2[18][9] = {
    {0, 0, 0, 0, 0, 0, 0, 0, 0},
    {1, 0, 0, 0, 0, 0, 0, 0, 0},
    {1, 1, 0, 0, 0, 0, 0, 0, 0},
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    {0, 0, 0, 0, 0, 0, 0, 0, 1},
};

int animation3[3][9] = {
    {1, 0, 0, 1, 0, 0, 1, 0, 0},
    {0, 1, 0, 0, 1, 0, 0, 1, 0},
    {0, 0, 1, 0, 0, 1, 0, 0, 1},
};

int animation4[32][9] = {
    {1, 0, 0, 0, 0, 0, 0, 0, 0},
    {1, 1, 0, 0, 0, 0, 0, 0, 0},
    {1, 0, 1, 0, 0, 0, 0, 0, 0},
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    {1, 1, 0, 0, 0, 0, 0, 0, 0},
};

void setLedPattern(int *p) {
    for (int i = 0; i < numleds; i++) {
        setLed(i, p[i]);
    }
}

void playAnimation(int frames[][9], int numframes, int duration) {
    for (int count = 0; count < duration; count++) {
        for (int i = 0; i < numframes; i++) {
            setLedPattern(frames[i]);
            delay(80);
        }
    }
}

void loop() {
    playAnimation(animation1, 12, 10);
    playAnimation(animation2, 18, 10);
    playAnimation(animation3, 3, 50);
    playAnimation(animation4, 32, 10);
}

